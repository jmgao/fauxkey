## west.yml
```yaml
manifest:
  self:
    path: fauxkey
  remotes:
    - name: zephyrproject-rtos
      url-base: https://github.com/zephyrproject-rtos
  projects:
    - name: zephyr
      remote: zephyrproject-rtos
      revision: zephyr-v3.5.0
      import: true
```
